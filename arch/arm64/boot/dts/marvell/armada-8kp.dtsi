// SPDX-License-Identifier: (GPL-2.0+ OR MIT)
/*
 * Copyright (C) 2018 Marvell Technology Group Ltd.
 *
 * Device Tree file with definitions common to all Armada 8KP SoCs.
 */

#include "armada-common.dtsi"

#define CP110_ICU_MSI_PARENT <&gic>
#define CP110_XOR_MSI_PARENT(x) <&AP810_LABEL(gic_its) (0x42 + x)>  /* FIXME */
#define CP110_PCIE_MSI_PARENT(x) <&AP810_LABEL(gic_its) (0x42 + x)> /* FIXME */

#define CP110_PCIE_MEM_SIZE			(0xfff00000)
#define CP110_PCIEx_CPU_IO_BASE(iface)		(ADDRESSIFY(CP110_BASE) + 0x01fffe0000 + (iface) * 0x0200000000)
#define CP110_PCIEx_CPU_MEM_BASE(iface)		(ADDRESSIFY(CP110_BASE) + 0x0100000000 + (iface) * 0x0200000000)
#define CP110_PCIEx_BUS_IO_BASE(iface)		(CP110_PCIEx_CPU_IO_BASE(iface) - CP110_PCIEx_CPU_MEM_BASE(iface))
#define CP110_PCIEx_CONF_BASE(iface)		(CP110_PCIEx_CPU_MEM_BASE(iface) + CP110_PCIE_MEM_SIZE)
#define CP110_PCIEx_BUS_MEM_BASE(iface)		(0x0)
#define CP110_PCIE_MEM_CFG			(0x83000000)
