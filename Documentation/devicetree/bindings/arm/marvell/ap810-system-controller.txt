## Documentation/devicetree/bindings/arm/marvell/ap810-system-controller.txt
```
Marvell Armada AP810 System Controller
======================================

The AP810 is one of the two core HW blocks of the Marvell Armada 8KP
SoCs. It contains a system controller, which provides a number
registers giving access to numerous features: clocks, pin-muxing and
many other SoC configuration items. This DT binding allows to describe
this system controller.

For the top level node:
 - compatible: must be: "syscon", "simple-mfd";
  - reg: register area of the AP810 system controller

Pinctrl:
--------

For common binding part and usage, refer to
Documentation/devicetree/bindings/pinctrl/marvell,mvebu-pinctrl.txt.

Required properties:
- compatible must be "marvell,ap810-pinctrl",

Available mpp pins/groups and functions:
Note: brackets (x) are not part of the mpp name for marvell,function and given
only for more detailed description in this document.

name	pins	functions
================================================================================
mpp0	0	gpio, sdio(clk), i2c0(sda)
mpp1	1	gpio, sdio(cmd), i2c0(sck)
mpp2	2	gpio, sdio(d0), uart1(rxd)
mpp3	3	gpio, sdio(d1)
mpp4	4	gpio, sdio(d2), uart1(txd)
mpp5	5	gpio, sdio(d3)
mpp6	6	gpio, sdio(ds), spi0(cs1n)
mpp7	7	gpio, sdio(d4), spi0(clk), uart1(rxd)
mpp8	8	gpio, sdio(d5), spi0(miso), uart1(txd)
mpp9	9	gpio, sdio(d6), spi0(mosi)
mpp10	10	gpio, sdio(d7), spi0(cs0n)
mpp11	11	gpio, uart0(txd)
mpp12	12	gpio, sdio(pw_off), sdio(hw_rst), sdio(sd_pwr0)
mpp13	13	gpio, mss-gpio, sdio(sd_pwr1)
mpp14	14	gpio, mss-gpio, sdio(sd_v18en)
mpp15	15	gpio, mss-gpio
mpp16	16	gpio, mss-gpio
mpp17	17	gpio, mss-gpio, i2c0(sda)
mpp18	18	gpio, mss-gpio, i2c0(sck), sdio(pw_off)
mpp19	19	gpio, mss-gpipo, uart0(rxd)

GPIO:
-----
For common binding part and usage, refer to
Documentation/devicetree/bindings/gpio/gpio-mvebu.txt.

Required properties:

- compatible: "marvell,armada-8k-gpio"

- offset: offset address inside the syscon block

Example:
ap_syscon: system-controller@6f4000 {
	compatible = "syscon", "simple-mfd";
	reg = <0x6f4000 0x1000>;

	ap_pinctrl: pinctrl {
		compatible = "marvell,ap810-pinctrl";
	};

	ap_gpio: gpio {
		compatible = "marvell,armada-8k-gpio";
		offset = <0x1040>;
		ngpios = <21>;
		gpio-controller;
		#gpio-cells = <2>;
		gpio-ranges = <&ap_pinctrl 0 0 21>;
	};
};
```

## Documentation/devicetree/bindings/arm/marvell/armada-3700-avs.txt
```
Marvell Armada 3700 Adaptive Voltage Scaling
============================================


avs: avs@14000 {
	compatible = "marvell,armada-3700-avs", "syscon";
	reg = <0x11500 0x40>;
};
```

## Documentation/devicetree/bindings/arm/marvell/armada-8kp.txt
```
Marvell Armada 8KPlus Platforms Device Tree Bindings
----------------------------------------------------

Boards using a SoC of the Marvell Armada 8KP families must carry
the following root node property:

 - compatible, with one of the following values:

   - "marvell,armada-ap810"

Example:

compatible = "marvell,armada-ap810"
```

## Documentation/devicetree/bindings/phy/mvebu-serdes-phy.txt
```
* Marvell EBU SERDES PHY

Allows to control the SERDES lanes, which are used for PCIe, SATA,
SGMII and QSGMII. This binding applies to the Armada 370 and Armada XP
SoCs.

Required properties:
- compatible: depending on the SoC, one of the following values:
   marvell,mv88f6710-serdes
   marvell,mv78230-serdes
   marvell,mv78260-serdes
   marvell,mv78460-serdes
- reg: base address and length of the registers
- #phys-cells: should be 2
   the first cell corresponds to the SERDES lane number
   the second cell corresponds to the mode into which the SERDES lane
   should be configured

Example:

	serdes@18270 {
		compatible = "marvell,mv78460-serdes";
		reg = <0x18270 0x8>;
		#phy-cells = <2>;
	};
```

## Documentation/devicetree/bindings/serial/mvebu-uart.txt
```
* Marvell UART : Non standard UART used in some of Marvell EBU SoCs
                 e.g., Armada-3700.

Required properties:
- compatible: "marvell,armada-3700-uart" matches the standard, not
	      extended UART IP.
	      "marvell,armada-3700-uart-ext" is for the extended UART
	      port which has an extended IP and also some
	      registers/bitfields that moved compared to the other IP.
	      Using a different compatible for this type of port
	      allows to automatically select the right offsets.
- reg: offset and length of the register set for the device.
- clocks: UART reference clock used to derive the baudrate.
- interrupts: device interrupts. Each UART IP has two interrupt lines,
              dedicated to both RX and TX interrupts, so called "uart-rx"
	      and "uart-tx". The standard (ie. not extendend) port has a
	      third interrupt line which is an OR of both RX and TX
	      interrupts, so called "uart-sum". The driver currently
	      uses "uart-rx" and "uart-tx" for both ports whereas older
	      versions used only the summed interrupt (when only the
	      standard UART port was supported). The standard port uses
	      level interrupts while the extended port uses front
	      interrupts.

Example:
	uart0: serial@12000 {
		compatible = "marvell,armada-3700-uart";
		reg = <0x12000 0x200>;
		clocks = <&xtalclk>;
		interrupts =
		<GIC_SPI 11 IRQ_TYPE_LEVEL_HIGH>,
		<GIC_SPI 12 IRQ_TYPE_LEVEL_HIGH>,
		<GIC_SPI 13 IRQ_TYPE_LEVEL_HIGH>;
		interrupt-names = "uart-sum", "uart-tx", "uart-rx";
		status = "disabled";
	};

	uart1: serial@12200 {
		compatible = "marvell,armada-3700-uart-ext";
		reg = <0x12200 0x30>;
		clocks = <&xtalclk>;
		interrupts =
		<GIC_SPI 30 IRQ_TYPE_EDGE_RISING>,
		<GIC_SPI 31 IRQ_TYPE_EDGE_RISING>;
		interrupt-names = "uart-tx", "uart-rx";
		status = "disabled";
	};
```
